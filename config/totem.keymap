#define ZMK_RU_LAYER(name, LT, RT, LM, RM, LB, RB, LH, RH)   \
    ZMK_LAYER(                                                \
        name,                                                  \
                             LT  RT                             \
                             LM  RM                              \
                &ru_kh       LB  RB     &ru_hard                  \
                &tog GAME    LH  RH     &tog GAME                  \
    )

#define ZMK_OTHERS_LAYER(name, LT, RT, LM, RM, LB, RB, LH, RH)   \
    ZMK_LAYER(                                                    \
        name,                                                      \
                             LT  RT                                 \
                             LM  RM                                  \
                &none        LB  RB     &none                         \
                &tog GAME    LH  RH     &tog GAME                      \
    )  

#include <zmk-helpers/key-labels/totem.h>
#include "base.keymap"

// extra combos for 36 layout
MIRROR_COMBO(esc_36,       &kp ESC,                     T3, T4,    SYM_COMBOS_LAYERS GAME)
MIRROR_COMBO(b2_36,        &kp TILDE,     &kp GRAVE,    B2, B3,    RU)