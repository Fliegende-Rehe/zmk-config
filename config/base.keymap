#include "includes/aliases.dtsi"
#include "includes/combos.dtsi"

#ifndef ZMK_OTHERS_LAYER
  #define ZMK_OTHERS_LAYER(name, LT, RT, LM, RM, LB, RB, LH, RH)                 \
      ZMK_LAYER(name, LT RT LM RM LB RB LH RH)
#endif


ZMK_OTHERS_LAYER(base_en,
       // ╭──────────────┬──────────────┬──────────────┬──────────────┬──────────────╮   ╭──────────────┬──────────────┬──────────────┬──────────────┬──────────────╮
             &kp Q          &kp W         &kp E           &kp R          &kp T         ,       &kp Y          &kp U          &kp I            &kp O         &kp P   , 
       // ├──────────────┼──────────────┼──────────────┼──────────────┼──────────────┤   ├──────────────┼──────────────┼──────────────┼──────────────┼──────────────┤
             HML_GUI(A)     HML_ALT(S)    HML_SHFT(D)    HML_CTRL(F)    &kp G          ,      &kp H         HMR_CTRL(J)     HMR_SHFT(K)   HMR_ALT(L)    &kp RGUI    ,
       // ├──────────────┼──────────────┼──────────────┼──────────────┼──────────────┤   ├──────────────┼──────────────┼──────────────┼──────────────┼──────────────┤
            &lt MOUSE Z          &kp X         &kp C           &kp V         &kp B     ,          &kp N          &kp M            XXX            XXX     &mo MOUSE  , 
       // ╰──────────────┴──────────────┼──────────────┼──────────────┼──────────────┤   ├──────────────┼──────────────┼──────────────┼──────────────┴──────────────╯
                                                         &lt NUM TAB     &lt NAV SPACE ,     &lt NAV RET    &lt NUM BSPC 
       //                                              ┴──────────────┴──────────────╯   ╰──────────────┴──────────────╯
)

#ifndef ZMK_RU_LAYER
  #define ZMK_RU_LAYER(name, LT, RT, LM, RM, LB, RB, LH, RH)                 \
      ZMK_LAYER(name, LT RT LM RM LB RB LH RH)
#endif

ZMK_RU_LAYER(base_ru,
       // ╭──────────────┬──────────────┬──────────────┬──────────────┬──────────────╮   ╭──────────────┬──────────────┬──────────────┬──────────────┬──────────────╮
              &ru_y          &ru_ts         &ru_u         &ru_k            &ru_ye      ,      &ru_n         &ru_g          &ru_sh         &ru_shch      &ru_z       ,
       // ├──────────────┼──────────────┼──────────────┼──────────────┼──────────────┤   ├──────────────┼──────────────┼──────────────┼──────────────┼──────────────┤
              UHT_RU_F       UHT_RU_BI      UHT_RU_V      UHT_RU_A         &ru_p       ,      &ru_r         UHT_RU_O       UHT_RU_L       UHT_RU_D      UHT_RU_ZH   ,
       // ├──────────────┼──────────────┼──────────────┼──────────────┼──────────────┤   ├──────────────┼──────────────┼──────────────┼──────────────┼──────────────┤
              UHT_RU_YA         &ru_ch         &ru_s         &ru_m            &ru_i    ,         &ru_t         &ru_soft       &ru_b          &ru_yu        UHT_RU_E , 
       // ╰──────────────┴──────────────┼──────────────┼──────────────┼──────────────┤   ├──────────────┼──────────────┼──────────────┼──────────────┴──────────────╯
                                                          &lt NUM TAB    &lt NAV SPACE ,    &lt NAV RET    &lt NUM BSPC 
       //                                              ┴──────────────┴──────────────╯   ╰──────────────┴──────────────╯
)

ZMK_OTHERS_LAYER(num,
       // ╭──────────────┬──────────────┬──────────────┬──────────────┬──────────────╮   ╭──────────────┬──────────────┬──────────────┬──────────────┬────────────── ╮
              &kp N1         &kp N2         &kp N3         &kp N4         &kp N5         ,    &kp N6          &kp N7         &kp N8         &kp N9         &kp N0    , 
       // ├──────────────┼──────────────┼──────────────┼──────────────┼──────────────┤    ├──────────────┼──────────────┼──────────────┼──────────────┼──────────────┤
           HML_GUI(EXCL)  HML_ALT(AT) HML_SHFT(HASH)  HML_CTRL(DLLR)   &kp PRCNT         ,    &kp CARET     HMR_CTRL(AMPS) HMR_SHFT(STAR) HMR_ALT(LBRC) HMR_GUI(RBRC),
       // ├──────────────┼──────────────┼──────────────┼──────────────┼──────────────┤    ├──────────────┼──────────────┼──────────────┼──────────────┼──────────────┤
                &f1_f11        &f2_f12     &kp F3        &kp F4        &kp F5            ,   &kp F6        &kp F7           &kp F8        &kp F9         &kp F10     , 
       // ╰──────────────┴──────────────┼──────────────┼──────────────┼──────────────┤    ├──────────────┼──────────────┼──────────────┼──────────────┴──────────────╯
                                                            ___          &kp SPACE       ,  &kp RET           ___        
       //                                              ┴──────────────┴──────────────╯    ╰──────────────┴──────────────╯
)

ZMK_OTHERS_LAYER(nav,
       // ╭──────────────┬──────────────┬──────────────┬──────────────┬──────────────╮   ╭──────────────┬──────────────┬──────────────┬──────────────┬──────────────╮
             &kp LGUI        ZOOM_OUT        &kp UP        ZOOM_IN         BACK         ,    FORWARD         SNAP_LEFT      &kp UP         SNAP_RIGHT     &kp RGUI  ,
       // ├──────────────┼──────────────┼──────────────┼──────────────┼──────────────┤   ├──────────────┼──────────────┼──────────────┼──────────────┼──────────────┤
             &kp LSHFT      &kp LEFT        &kp DOWN      &kp RIGHT       &kp HOME      ,   &kp END         &kp LEFT        &kp DOWN      &kp RIGHT     &kp RSHFT   ,
       // ├──────────────┼──────────────┼──────────────┼──────────────┼──────────────┤   ├──────────────┼──────────────┼──────────────┼──────────────┼──────────────┤
            &kp LCTRL      &kp C_PREV      &kp C_PP      &kp C_NEXT      &kp CAPS       ,  SNIP_TOOL       VOL_DN         VOL_MUTE       VOL_UP        &kp RCTRL    , 
       // ╰──────────────┴──────────────┼──────────────┼──────────────┼──────────────┤   ├──────────────┼──────────────┼──────────────┼──────────────┴──────────────╯
                                                          &kp DEL           ___         ,      ___          &kp BSPC    
       //                                              ┴──────────────┴──────────────╯   ╰──────────────┴──────────────╯
)

ZMK_OTHERS_LAYER(mouse,
       // ╭──────────────┬──────────────┬──────────────┬──────────────┬──────────────╮   ╭──────────────┬──────────────┬──────────────┬──────────────┬──────────────╮
             &none          MSC_DOWN        MMV_UP         MSC_UP         BACK        ,     FORWARD         MSC_UP         MMV_UP         MSC_DOWN           &none  ,
       // ├──────────────┼──────────────┼──────────────┼──────────────┼──────────────┤   ├──────────────┼──────────────┼──────────────┼──────────────┼──────────────┤
             &none       MMV_LEFT        MMV_DOWN       MMV_RIGHT     SNAP_LEFT     ,   SNAP_RIGHT        MMV_LEFT       MMV_DOWN         MMV_RIGHT         &none   ,
       // ├──────────────┼──────────────┼──────────────┼──────────────┼──────────────┤   ├──────────────┼──────────────┼──────────────┼──────────────┼──────────────┤ 
                ___          &kp LC(V)       &kp LC(C)      &kp LSHFT     &kp LCTRL     ,    &kp LCTRL      &kp LSHFT       &kp LC(C)      &kp LC(V)      ___       ,
       // ╰──────────────┴──────────────┼──────────────┼──────────────┼──────────────┤   ├──────────────┼──────────────┼──────────────┼──────────────┴──────────────╯
                                                         &mkp RCLK       &mkp LCLK      ,   &mkp LCLK     &mkp RCLK     
       //                                              ┴──────────────┴──────────────╯   ╰──────────────┴──────────────╯
)

ZMK_OTHERS_LAYER(game,
       // ╭──────────────┬──────────────┬──────────────┬──────────────┬──────────────╮   ╭──────────────┬──────────────┬──────────────┬──────────────┬──────────────╮
             &kp TAB        &kp Q          &kp W          &kp E          &kp R          ,    &kp T          MIC_MUTE          &kp UP      HEAD_MUTE        &kp F2   ,
       // ├──────────────┼──────────────┼──────────────┼──────────────┼──────────────┤    ├──────────────┼──────────────┼──────────────┼──────────────┼─────────────┤
             &kp LSHFT      &kp A          &kp S          &kp D          &kp F          ,    &kp Y          &kp LEFT        &kp DOWN      &kp RIGHT      &kp F5     ,
       // ├──────────────┼──────────────┼──────────────┼──────────────┼──────────────┤    ├──────────────┼──────────────┼──────────────┼──────────────┼─────────────┤
            &kp LCTRL      &kp Z          &kp X          &kp C          &kp V           ,   &kp U          VOL_DN          VOL_MUTE       VOL_UP         &kp F6     ,   
       // ╰──────────────┴──────────────┼──────────────┼──────────────┼──────────────┤    ├──────────────┼──────────────┼──────────────┼──────────────┴─────────────╯
                                                          &kp LALT       &kp SPACE      ,    &kp ENTER      &tog GAME      
       //                                              ┴──────────────┴──────────────╯    ╰──────────────┴──────────────╯
)

ZMK_OTHERS_LAYER(sys,
       // ╭──────────────┬──────────────┬──────────────┬──────────────┬──────────────╮   ╭──────────────┬──────────────┬──────────────┬──────────────┬──────────────╮
              XXX             XXX           XXX            XXX              XXX         ,     XXX              XXX          XXX            XXX            XXX       ,
       // ├──────────────┼──────────────┼──────────────┼──────────────┼──────────────┤   ├──────────────┼──────────────┼──────────────┼──────────────┼──────────────┤
              XXX             XXX           BT_1           XXX              XXX         ,     XXX              XXX          BT_1           XXX            XXX       ,
       // ├──────────────┼──────────────┼──────────────┼──────────────┼──────────────┤   ├──────────────┼──────────────┼──────────────┼──────────────┼──────────────┤
              BOOT            BT_0          BT_CLEAR       BT_2         &out OUT_TOG    ,  &out OUT_TOG        BT_2         BT_CLEAR       BT_0           BOOT      ,   
       // ╰──────────────┴──────────────┼──────────────┼──────────────┼──────────────┤   ├──────────────┼──────────────┼──────────────┼──────────────┴──────────────╯
                                                           XXX              XXX         ,       XXX            XXX       
       //                                              ┴──────────────┴──────────────╯   ╰──────────────┴──────────────╯
)
