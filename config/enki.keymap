#include <behaviors/rgbled_widget.dtsi>

#define ZMK_RU_LAYER(name, LT, RT, LM, RM, LB, RB, LH, RH)     \
    ZMK_LAYER(                                                  \
        name,                                                    \
                    &none       LT  RT     &none                  \
                    &none       LM  RM     &none                   \
                    &ru_kh      LB  RB     &ru_hard                 \
                    &none       LH  RH     &none                     \
    )

#define ZMK_OTHERS_LAYER(name, LT, RT, LM, RM, LB, RB, LH, RH)   \
    ZMK_LAYER(                                                    \
        name,                                                      \
                    &none       LT  RT     &none                    \
                    &none       LM  RM     &none                     \
                    &none       LB  RB     &none                      \
                    &none       LH  RH     &none                       \
    )

#include <zmk-helpers/key-labels/42.h>
#include "base.keymap"

// extra combos for 42 layout
MIRROR_COMBO(t4_42,    &kp ESC,        &kp ESC,      T4, T5,      SYM_COMBOS_LAYERS)
MIRROR_COMBO(t3_42,    &kp EXCL,       &kp AT,       T3, T4,      SYM_COMBOS_LAYERS)
MIRROR_COMBO(m4_42,    &kp PRCNT,      &kp CARET,    M4, M5,      SYM_COMBOS_LAYERS)  
MIRROR_COMBO(b4_42,    &kp DLLR,       &kp AMPS,     B4, B5,      SYM_COMBOS_LAYERS)
MIRROR_COMBO(b2_42,    &kp TILDE,      &kp GRAVE,    B2, B3,      RU)

ZMK_COMBO(game_tog_34,      &tog GAME,         LH1 RH1,   BASE GAME) 