#include <behaviors/unicode.dtsi>
#include "russian_parsed.dtsi"

&uc {
    default-mode = <UC_MODE_WIN_COMPOSE>;
    win-compose-key = <RALT>;
    minimum-length = <4>;
};

#define RU_SYM_TAP_MS 20

#define MOD_RU_SYM(NAME, LOWER_UNICODE, UPPER_UNICODE, EN_SYM)    \
    ZMK_MACRO(lower_##NAME,                                       \
        tap-ms = <RU_SYM_TAP_MS>;                                 \
        wait-ms = <0>;                                            \
        bindings = <&uc LOWER_UNICODE 0>;                         \
    )                                                             \
    ZMK_MACRO(upper_##NAME,                                       \
        tap-ms = <RU_SYM_TAP_MS>;                                 \
        wait-ms = <0>;                                            \
        bindings = <&uc UPPER_UNICODE 0>;                         \
    )                                                             \
    ZMK_MOD_MORPH(RU_##NAME,                                      \
        bindings = <&lower_##NAME>, <&upper_##NAME>;              \
        mods = <(MOD_LSFT|MOD_RSFT)>;                             \
    )                                                             \
    ZMK_MOD_MORPH(NAME,                                           \
        bindings = <&RU_##NAME>, <&kp EN_SYM>;                    \
        mods = <(MOD_LCTL|MOD_RCTL|MOD_LGUI|MOD_RGUI)>;           \
        keep-mods = <(MOD_LCTL|MOD_RCTL|MOD_LGUI|MOD_RGUI)>;      \
    )                                                             \

MOD_RU_SYM(ru_a,       UC_RU_A_LOWER   , UC_RU_A_UPPER   ,   F     )   // а/f
MOD_RU_SYM(ru_b,       UC_RU_B_LOWER   , UC_RU_B_UPPER   ,   COMMA )   // б/,
MOD_RU_SYM(ru_v,       UC_RU_V_LOWER   , UC_RU_V_UPPER   ,   D     )   // в/d
MOD_RU_SYM(ru_g,       UC_RU_G_LOWER   , UC_RU_G_UPPER   ,   U     )   // г/u
MOD_RU_SYM(ru_d,       UC_RU_D_LOWER   , UC_RU_D_UPPER   ,   L     )   // д/l
MOD_RU_SYM(ru_ye,      UC_RU_YE_LOWER  , UC_RU_YE_UPPER  ,   T     )   // е/t 
MOD_RU_SYM(ru_yo,      UC_RU_YO_LOWER  , UC_RU_YO_UPPER  ,   GRAVE )   // ё/`
MOD_RU_SYM(ru_zh,      UC_RU_ZH_LOWER  , UC_RU_ZH_UPPER  ,   SEMI  )   // ж/;
MOD_RU_SYM(ru_z,       UC_RU_Z_LOWER   , UC_RU_Z_UPPER   ,   P     )   // з/p
MOD_RU_SYM(ru_i,       UC_RU_I_LOWER   , UC_RU_I_UPPER   ,   B     )   // и/b
MOD_RU_SYM(ru_y,       UC_RU_Y_LOWER   , UC_RU_Y_UPPER   ,   Q     )   // й/q
MOD_RU_SYM(ru_k,       UC_RU_K_LOWER   , UC_RU_K_UPPER   ,   R     )   // к/r
MOD_RU_SYM(ru_l,       UC_RU_L_LOWER   , UC_RU_L_UPPER   ,   K     )   // л/k
MOD_RU_SYM(ru_m,       UC_RU_M_LOWER   , UC_RU_M_UPPER   ,   V     )   // м/v
MOD_RU_SYM(ru_n,       UC_RU_N_LOWER   , UC_RU_N_UPPER   ,   Y     )   // н/y
MOD_RU_SYM(ru_o,       UC_RU_O_LOWER   , UC_RU_O_UPPER   ,   J     )   // о/j 
MOD_RU_SYM(ru_p,       UC_RU_P_LOWER   , UC_RU_P_UPPER   ,   G     )   // п/g
MOD_RU_SYM(ru_r,       UC_RU_R_LOWER   , UC_RU_R_UPPER   ,   H     )   // р/h
MOD_RU_SYM(ru_s,       UC_RU_S_LOWER   , UC_RU_S_UPPER   ,   C     )   // с/c 
MOD_RU_SYM(ru_t,       UC_RU_T_LOWER   , UC_RU_T_UPPER   ,   N     )   // т/n
MOD_RU_SYM(ru_u,       UC_RU_U_LOWER   , UC_RU_U_UPPER   ,   E     )   // у/e
MOD_RU_SYM(ru_f,       UC_RU_F_LOWER   , UC_RU_F_UPPER   ,   A     )   // ф/a
MOD_RU_SYM(ru_kh,      UC_RU_KH_LOWER  , UC_RU_KH_UPPER  ,   LBKT  )   // х/[ 
MOD_RU_SYM(ru_ts,      UC_RU_TS_LOWER  , UC_RU_TS_UPPER  ,   W     )   // ц/w
MOD_RU_SYM(ru_ch,      UC_RU_CH_LOWER  , UC_RU_CH_UPPER  ,   X     )   // ч/x
MOD_RU_SYM(ru_sh,      UC_RU_SH_LOWER  , UC_RU_SH_UPPER  ,   I     )   // ш/i
MOD_RU_SYM(ru_shch,    UC_RU_SHCH_LOWER, UC_RU_SHCH_UPPER,   O     )   // щ/o
MOD_RU_SYM(ru_hard,    UC_RU_HARD_LOWER, UC_RU_HARD_UPPER,   RBKT  )   // ъ/]
MOD_RU_SYM(ru_bi,      UC_RU_BI_LOWER  , UC_RU_BI_UPPER  ,   S     )   // ы/s
MOD_RU_SYM(ru_soft,    UC_RU_SOFT_LOWER, UC_RU_SOFT_UPPER,   M     )   // ь/m
MOD_RU_SYM(ru_e,       UC_RU_E_LOWER   , UC_RU_E_UPPER   ,   SQT   )   // э/'
MOD_RU_SYM(ru_yu,      UC_RU_YU_LOWER  , UC_RU_YU_UPPER  ,   DOT   )   // ю/.
MOD_RU_SYM(ru_ya,      UC_RU_YA_LOWER  , UC_RU_YA_UPPER  ,   Z     )   // я/Z
    
ZMK_MACRO(uc_dim, bindings = <&uc 0x2300 0>;)  
ZMK_MACRO(uc_deg, bindings = <&uc 0x00b0 0>;)    
