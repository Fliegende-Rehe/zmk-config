#include "behaviours.dtsi"

// Hardware
#define XXX           &none
#define ___           &trans
#define BT_0          &bt BT_SEL 0
#define BT_1          &bt BT_SEL 1
#define BT_2          &bt BT_SEL 2
#define BT_CLEAR      &bt BT_CLR
#define BOOT          &bootloader
#define RESET         &sys_reset

// Mouse 
#define FORWARD       &mkp MB5
#define BACK          &mkp MB4

#define MMV_UP        &mmv MOVE_UP
#define MMV_DOWN      &mmv MOVE_DOWN
#define MMV_LEFT      &mmv MOVE_LEFT
#define MMV_RIGHT     &mmv MOVE_RIGHT

#define MSC_UP        &msc SCRL_UP
#define MSC_DOWN      &msc SCRL_DOWN
#define MSC_LEFT      &msc SCRL_LEFT
#define MSC_RIGHT     &msc SCRL_RIGHT

// Tools
#define ZOOM_IN       &kp LC(EQUAL)
#define ZOOM_OUT      &kp LC(MINUS)

#define SNAP_LEFT     &kp LS(LG(LEFT))
#define SNAP_RIGHT    &kp LS(LG(RIGHT))
#define SNIP_TOOL     &kp LS(LG(S))
#define ALL_APPS      &kp C_AC_DESKTOP_SHOW_ALL_APPLICATIONS
#define ALL_WINDOWS   &kp C_AC_DESKTOP_SHOW_ALL_WINDOWS

// Media & System
#define VOL_DN        &kp C_VOL_DN
#define VOL_UP        &kp C_VOL_UP
#define VOL_MUTE      &kp C_MUTE
#define MIC_MUTE      &kp LC(LS(M))
#define HEAD_MUTE     &kp LC(LS(D))

// Home-row mods (EN)
#define HML_GUI(KEY)    &hml LGUI  KEY
#define HML_ALT(KEY)    &hml LALT  KEY
#define HML_SHFT(KEY)   &hml LSHFT KEY
#define HML_CTRL(KEY)   &hml LCTRL KEY

#define HMR_CTRL(KEY)   &hmr RCTRL KEY
#define HMR_SHFT(KEY)   &hmr RSHFT KEY
#define HMR_ALT(KEY)    &hmr LALT  KEY 
#define HMR_GUI(KEY)    &hmr RGUI  KEY

// unicode home row mode (RU)
#define UHT_RU_F     &uht_f    LGUI  0
#define UHT_RU_BI    &uht_bi   LALT  0
#define UHT_RU_V     &uht_v    LSHFT 0
#define UHT_RU_A     &uht_a    LCTRL 0

#define UHT_RU_O     &uht_o    RCTRL 0
#define UHT_RU_L     &uht_l    RSHFT 0
#define UHT_RU_D     &uht_d    LALT  0
#define UHT_RU_ZH    &uht_zh   RGUI  0

// unicode layer tap
#define UHT_RU_YA    &uht_ya   MOUSE  0
#define UHT_RU_E     &uht_e    MOUSE  0
