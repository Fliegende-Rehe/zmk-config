// layers
#define EN      0
#define RU      1
#define NUM     2
#define NAV     3
#define MOUSE   4
#define GAME    5
#define SYS     6

#define BASE    RU EN

// behaviours params
#define QUICK_TAP_MS                    150
#define TAPPING_TERM_MS                 200 
#define REQUIRE_PRIOR_IDLE_MS           100
#define FLAVOR                          "balanced"

// mouse
#define ZMK_POINTING_DEFAULT_MOVE_VAL   2250 // 600
#define ZMK_POINTING_DEFAULT_SCRL_VAL   150  // 10
#define MMV_TIME_TO_MAX_SPEED           500
#define MSC_TIME_TO_MAX_SPEED           40   // 300 
#define POINTING_TRIGGER_PERIOD_MS      16

#include <behaviors.dtsi>
#include <dt-bindings/zmk/keys.h>
#include <dt-bindings/zmk/bt.h>
#include <dt-bindings/zmk/outputs.h>
#include <dt-bindings/zmk/pointing.h>
#include <input/processors.dtsi>
#include <zephyr/dt-bindings/input/input-event-codes.h>

#include <zmk-helpers/helper.h>

#include "unicode.dtsi"

&lt {
    flavor = FLAVOR;
    tapping-term-ms = <TAPPING_TERM_MS>; 
    quick-tap-ms = <QUICK_TAP_MS>;
};

&mmv {
    acceleration-exponent = <1>;     
    time-to-max-speed-ms = <MMV_TIME_TO_MAX_SPEED>;     
    trigger-period-ms = <POINTING_TRIGGER_PERIOD_MS>;
};

&msc {
    acceleration-exponent = <1>;   
    time-to-max-speed-ms = <MSC_TIME_TO_MAX_SPEED>;      
    trigger-period-ms = <POINTING_TRIGGER_PERIOD_MS>;
};

#define MAKE_HRM(NAME, HOLD, TAP, TRIGGER_POS)                 \
    ZMK_HOLD_TAP(NAME,                                          \
                 bindings = <HOLD>, <TAP>;                       \
                 flavor = FLAVOR;                                 \
                 tapping-term-ms = <TAPPING_TERM_MS>;              \
                 quick-tap-ms = <QUICK_TAP_MS>;                     \
                 require-prior-idle-ms = <REQUIRE_PRIOR_IDLE_MS>;    \
                 hold-trigger-on-release;                             \
                 hold-trigger-key-positions = <TRIGGER_POS>;           \
    )

#define MAKE_LT(NAME, HOLD, TAP)                                  \
    ZMK_HOLD_TAP(NAME,                                             \
                 bindings = <HOLD>, <TAP>;                          \
                 flavor = FLAVOR;                                    \
                 tapping-term-ms = <TAPPING_TERM_MS>;                 \
                 quick-tap-ms = <QUICK_TAP_MS>;                        \
                 require-prior-idle-ms = <REQUIRE_PRIOR_IDLE_MS>;       \
    )

// keys groups
#define KEYS_L LM4 LM3 LM2 LM1 
#define KEYS_R RM1 RM2 RM3 RM4 

// hold tap
MAKE_HRM(hml, &kp, &kp, KEYS_L) 
MAKE_HRM(hmr, &kp, &kp, KEYS_R)

// unicode hold tap
MAKE_HRM(uht_f,    &kp, &ru_f,    KEYS_L) 
MAKE_HRM(uht_bi,   &kp, &ru_bi,   KEYS_L) 
MAKE_HRM(uht_v,    &kp, &ru_v,    KEYS_L) 
MAKE_HRM(uht_a,    &kp, &ru_a,    KEYS_L) 
  
MAKE_HRM(uht_o,    &kp, &ru_o,    KEYS_R) 
MAKE_HRM(uht_l,    &kp, &ru_l,    KEYS_R) 
MAKE_HRM(uht_d,    &kp, &ru_d,    KEYS_R) 
MAKE_HRM(uht_zh,   &kp, &ru_zh,   KEYS_R) 

MAKE_LT(uht_ya,    &mo, &ru_ya) 
MAKE_LT(uht_e,     &mo, &ru_e)

MAKE_HRM(uht_kh,   &kp, &ru_kh,   KEYS_L)   
MAKE_HRM(uht_hard, &kp, &ru_hard, KEYS_R) 

// tap dances
ZMK_TAP_DANCE(f1_f11,  bindings = <&kp F1>, <&kp F11>;)
ZMK_TAP_DANCE(f2_f12,  bindings = <&kp F2>, <&kp F12>;)
