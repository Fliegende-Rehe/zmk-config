## boards/shields/chonky_bois/Kconfig.defconfig
```kconfig
# Copyright (c) 2020 The ZMK Contributors
# SPDX-License-Identifier: MIT

if SHIELD_CHONKY_BOIS_LEFT || SHIELD_CHONKY_BOIS_RIGHT || SHIELD_CHONKY_BOIS_DONGLE

config ZMK_SPLIT
    default y

endif # SHIELD_CHONKY_BOIS_LEFT || SHIELD_CHONKY_BOIS_RIGHT || SHIELD_CHONKY_BOIS_DONGLE


if SHIELD_CHONKY_BOIS_DONGLE || SHIELD_CHONKY_BOIS_LEFT

config ZMK_SPLIT_ROLE_CENTRAL
    default y

endif # SHIELD_CHONKY_BOIS_LEFT || SHIELD_CHONKY_BOIS_DONGLE
```

## boards/shields/chonky_bois/Kconfig.shield
```kconfig
# Copyright (c) 2020 The ZMK Contributors
# SPDX-License-Identifier: MIT

config SHIELD_CHONKY_BOIS_LEFT
    def_bool $(shields_list_contains,chonky_bois_left)

config SHIELD_CHONKY_BOIS_RIGHT
    def_bool $(shields_list_contains,chonky_bois_right)

config SHIELD_CHONKY_BOIS_DONGLE
    def_bool $(shields_list_contains,chonky_bois_dongle)
```

## boards/shields/enki/Kconfig.defconfig
```kconfig
# Copyright (c) 2020 The ZMK Contributors
# SPDX-License-Identifier: MIT

if SHIELD_ENKI_LEFT || SHIELD_ENKI_RIGHT || SHIELD_ENKI_DONGLE

config ZMK_SPLIT
    default y

config ZMK_BLE
    default y

endif # SHIELD_ENKI_LEFT || SHIELD_ENKI_RIGHT || SHIELD_ENKI_DONGLE


if SHIELD_ENKI_DONGLE || SHIELD_ENKI_LEFT

config ZMK_SPLIT_ROLE_CENTRAL
    default y

if ZMK_SPLIT_ROLE_CENTRAL

config ZMK_KEYBOARD_NAME
    default "Enki42"

endif # ZMK_SPLIT_ROLE_CENTRAL

endif # SHIELD_ENKI_LEFT || SHIELD_ENKI_DONGLE
```

## boards/shields/enki/Kconfig.shield
```kconfig
# Copyright (c) 2020 The ZMK Contributors
# SPDX-License-Identifier: MIT

config SHIELD_ENKI_LEFT
	def_bool $(shields_list_contains,enki_left)

config SHIELD_ENKI_RIGHT
	def_bool $(shields_list_contains,enki_right)

config SHIELD_ENKI_DONGLE
    def_bool $(shields_list_contains,enki_dongle)
```

## boards/shields/nuke_pad/Kconfig.defconfig
```kconfig
# Copyright (c) 2020 The ZMK Contributors
# SPDX-License-Identifier: MIT

if SHIELD_NUKE_PAD

config ZMK_KEYBOARD_NAME
    default "NukePad"

endif
```

## boards/shields/nuke_pad/Kconfig.shield
```kconfig
# Copyright (c) 2020 The ZMK Contributors
# SPDX-License-Identifier: MIT

config SHIELD_NUKE_PAD
	def_bool $(shields_list_contains,nuke_pad)
```

## boards/shields/scoliosis/Kconfig.defconfig
```kconfig
# Copyright (c) 2020 The ZMK Contributors
# SPDX-License-Identifier: MIT

if SHIELD_SCOLIOSIS_LEFT || SHIELD_SCOLIOSIS_RIGHT || SHIELD_SCOLIOSIS_DONGLE

config ZMK_SPLIT
    default y

config ZMK_BLE
    default y

endif # SHIELD_SCOLIOSIS_LEFT || SHIELD_SCOLIOSIS_RIGHT || SHIELD_SCOLIOSIS_DONGLE


if SHIELD_SCOLIOSIS_DONGLE || SHIELD_SCOLIOSIS_LEFT

config ZMK_SPLIT_ROLE_CENTRAL
    default y

if ZMK_SPLIT_ROLE_CENTRAL

config ZMK_KEYBOARD_NAME
    default "Scoliosis34"

endif # ZMK_SPLIT_ROLE_CENTRAL

endif # SHIELD_SCOLIOSIS_LEFT || SHIELD_SCOLIOSIS_DONGLE
```

## boards/shields/scoliosis/Kconfig.shield
```kconfig
# Copyright (c) 2020 The ZMK Contributors
# SPDX-License-Identifier: MIT

config SHIELD_SCOLIOSIS_LEFT
    def_bool $(shields_list_contains,scoliosis_left)

config SHIELD_SCOLIOSIS_RIGHT
    def_bool $(shields_list_contains,scoliosis_right)

config SHIELD_SCOLIOSIS_DONGLE
    def_bool $(shields_list_contains,scoliosis_dongle)
```

## boards/shields/sofle/Kconfig.defconfig
```kconfig
# Copyright (c) 2020 Ryan Cross
# SPDX-License-Identifier: MIT

if SHIELD_SOFLE_LEFT || SHIELD_SOFLE_RIGHT || SHIELD_SHIELD_SOFLE_DONGLE

config ZMK_SPLIT
    default y

config ZMK_BLE
    default y

endif # SHIELD_SOFLE_LEFT || SHIELD_SOFLE_RIGHT || SHIELD_SHIELD_SOFLE_DONGLE


if SHIELD_SHIELD_SOFLE_DONGLE || SHIELD_SOFLE_LEFT

config ZMK_SPLIT_ROLE_CENTRAL
    default y

if ZMK_SPLIT_ROLE_CENTRAL

config ZMK_KEYBOARD_NAME
    default "Sofle"

endif # ZMK_SPLIT_ROLE_CENTRAL

endif # SHIELD_SOFLE_LEFT || SHIELD_SHIELD_SOFLE_DONGLE


if SHIELD_SOFLE_LEFT || SHIELD_SOFLE_RIGHT

if ZMK_DISPLAY

config I2C
    default y

config SSD1306
    default y

endif # ZMK_DISPLAY





if LVGL

config LV_Z_VDB_SIZE
    default 64

config LV_DPI_DEF
    default 148

config LV_Z_BITS_PER_PIXEL
    default 1

choice LV_COLOR_DEPTH
    default LV_COLOR_DEPTH_1
endchoice

endif # LVGL




endif
```

## boards/shields/totem/Kconfig.defconfig
```kconfig
# Copyright (c) 2020 The ZMK Contributors
# SPDX-License-Identifier: MIT

if SHIELD_TOTEM_LEFT || SHIELD_TOTEM_RIGHT || SHIELD_TOTEM_DONGLE

config ZMK_SPLIT
    default y

config ZMK_BLE
    default y

endif # SHIELD_TOTEM_LEFT || SHIELD_TOTEM_RIGHT || SHIELD_TOTEM_DONGLE


if SHIELD_TOTEM_DONGLE || SHIELD_TOTEM_LEFT

config ZMK_SPLIT_ROLE_CENTRAL
    default y

if ZMK_SPLIT_ROLE_CENTRAL

config ZMK_KEYBOARD_NAME
    default "Totem38"

endif # ZMK_SPLIT_ROLE_CENTRAL

endif # SHIELD_TOTEM_LEFT || SHIELD_TOTEM_DONGLE
```

## config/west.yml
```yaml
manifest:
  defaults:
    revision: main
    remote: urob

  remotes:
    - name: zmkfirmware
      url-base: https://github.com/zmkfirmware

    - name: janpfischer
      url-base: https://github.com/janpfischer

    - name: urob
      url-base: https://github.com/urob

    - name: englmaxi
      url-base: https://github.com/englmaxi

  projects:
    - name: zmk
      remote: zmkfirmware
      revision: v0.3.0
      import: app/west.yml

    - name: zmk-helpers
    - name: zmk-unicode
    - name: zmk-tri-state

    - name: zmk-dongle-screen
      remote: janpfischer

    - name: zmk-rgbled-widget
      url: https://github.com/caksoylar/zmk-rgbled-widget
      revision: v0.3

    - name: zmk-dongle-display
      remote: englmaxi
      revision: v0.3 

  self:
    path: config
```
